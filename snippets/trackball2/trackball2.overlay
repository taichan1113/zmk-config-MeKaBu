#include <zephyr/dt-bindings/input/input-event-codes.h>
#include <input/processors.dtsi>
#include <input/processors/xyz.dtsi>
#include "../pinctrl_i2c.dtsi"
#include "../listners.dtsi"


// &gpio1 {
//     sensor_wakeup {
//         gpio-hog;
//         gpios = <12 GPIO_ACTIVE_LOW>;
//         output-low;
//     };
// };

&i2c0 {
	status = "okay";
	compatible = "nordic,nrf-twim";
	pinctrl-0 = <&i2c0_default>;
	pinctrl-1 = <&i2c0_sleep>;
	pinctrl-names = "default", "sleep";
	clock-frequency = <I2C_BITRATE_FAST>;
    #address-cells = <1>;
    #size-cells = <0>;

	trackball2: trackball2@79 {
		status = "okay";
		compatible = "pixart,pat912x";
		reg = <0x79>; // HIGH:0x73, LOW:0x75, NC:0x79
		motion-gpios = <&gpio0 5 (GPIO_ACTIVE_LOW | GPIO_PULL_UP)>;
		res-x-cpi = <600>;
		res-y-cpi = <600>;
		zephyr,axis-x = <INPUT_REL_X>;
		zephyr,axis-y = <INPUT_REL_Y>;
		sleep1-enable;
		sleep2-enable;
	};
};

&split_peripheral {
    device = <&trackball2>;
	input-processors = <&zip_xyz>;
    // input-processors 
	// 	= <&zip_xy_transform INPUT_TRANSFORM_X_INVERT>
	// 	, <&zip_xy_transform INPUT_TRANSFORM_Y_INVERT>
	// 	, <&zip_xy_to_scroll_mapper>
	// 	;
    // scroller {
    //     layers = <0>;
    //     input-processors = <&zip_xy_transform INPUT_TRANSFORM_X_INVERT>
    //     , <&zip_xy_transform INPUT_TRANSFORM_Y_INVERT>
    //     , <&zip_xy_to_scroll_mapper>
    //     ;
    // };
};

// &pointer {
//     status = "okay";
//     device = <&trackball>;
// };

// &cpi_cyc{
//     status = "okay";
//     sensor_device = <&trackball>;
// };
