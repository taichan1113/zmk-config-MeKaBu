#include <zephyr/dt-bindings/input/input-event-codes.h>
#include <input/processors.dtsi>
#include "../pinctrl_i2c.dtsi"


// &gpio1 {
//     sensor_wakeup {
//         gpio-hog;
//         gpios = <12 GPIO_ACTIVE_LOW>;
//         output-low;
//     };
// };

&i2c1 {
	status = "okay";
	compatible = "nordic,nrf-twim";
	pinctrl-0 = <&i2c1_default>;
	pinctrl-1 = <&i2c1_sleep>;
	pinctrl-names = "default", "sleep";
	// clock-frequency = <I2C_BITRATE_FAST>;
    // #address-cells = <1>;
    // #size-cells = <0>;

	trackball: trackball_pat9125@79 {
		status = "okay";
		compatible = "pixart,pat9125";
		reg = <0x79>; // HIGH:0x73, LOW:0x75, NC:0x79
		motion-gpios = <&gpio1 13 (GPIO_ACTIVE_LOW | GPIO_PULL_UP)>;
		res-x-cpi = <300>;
		res-y-cpi = <300>;
		report-interval-ms = <10>;
		zephyr,axis-x = <INPUT_REL_X>;
		zephyr,axis-y = <INPUT_REL_Y>;
		// invert-x;
		invert-y;
		sleep1-enable;
		sleep2-enable;
	};
};

&listner_central {
    input-processors
        = <&zip_xy_transform INPUT_TRANSFORM_X_INVERT>
        ;
    scroller {
        layers = <1>;
        input-processors
            = <&zip_xy_transform INPUT_TRANSFORM_X_INVERT>
            , <&zip_xy_transform INPUT_TRANSFORM_Y_INVERT>
            , <&zip_xy_to_scroll_mapper>
            ;
    };
};

#ifdef MKB_ROLE_CENTRAL
&listner_central {
    status = "okay";
    device = <&trackball>;
	scroller {
        layers = <0>;
        input-processors
            = <&zip_xy_transform INPUT_TRANSFORM_X_INVERT>
            , <&zip_xy_transform INPUT_TRANSFORM_Y_INVERT>
            , <&zip_xy_to_scroll_mapper>
            ;
    };
};
#else
&trackball_split {
    status = "okay";
    device = <&trackball>;
	scroller {
        layers = <0>;
        input-processors
            = <&zip_xy_transform INPUT_TRANSFORM_X_INVERT>
            , <&zip_xy_transform INPUT_TRANSFORM_Y_INVERT>
            , <&zip_xy_to_scroll_mapper>
            ;
    };
};
#endif

// &pointer {
//     status = "okay";
//     device = <&trackball>;
// };

// &cpi_cyc{
//     status = "okay";
//     sensor_device = <&trackball>;
// };
