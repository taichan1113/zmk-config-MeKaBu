## boards/shields/MKB/Kconfig.shield
```kconfig
config SHIELD_CENTRAL
    def_bool $(shields_list_contains,Central)

config SHIELD_PERIPHERAL
    def_bool $(shields_list_contains,Peripheral)

config SHIELD_MKB_L
    def_bool $(shields_list_contains,MKB_L)

config SHIELD_MKB_R
    def_bool $(shields_list_contains,MKB_R)

config SHIELD_ENC_L
    def_bool $(shields_list_contains,ENC_L)

config SHIELD_ENC_R
    def_bool $(shields_list_contains,ENC_R)

config SHIELD_TB_C
    def_bool $(shields_list_contains,TB_C)

config SHIELD_TB_P
    def_bool $(shields_list_contains,TB_P)

config SHIELD_AS_C
    def_bool $(shields_list_contains,AS_C)

config SHIELD_AS_P
    def_bool $(shields_list_contains,AS_P)
```

## boards/shields/Modula/Kconfig.defconfig
```kconfig
if SHIELD_MODULA_L || SHIELD_MODULA_R
    config ZMK_KEYBOARD_NAME
        default "Modula"
    
    config NFCT_PINS_AS_GPIOS
        default y

    config ZMK_SPLIT
        default y
endif 
```

## boards/shields/Modula/Kconfig.shield
```kconfig
config SHIELD_MODULA_L
    def_bool $(shields_list_contains,Modula_left)

config SHIELD_MODULA_R
    def_bool $(shields_list_contains,MKB_R)
```

## config/west.yml
```yaml
manifest:
  remotes:
    - name: zmkfirmware
      url-base: https://github.com/zmkfirmware
    - name: caksoylar
      url-base: https://github.com/caksoylar
    - name: badjeff
      url-base: https://github.com/badjeff
    - name: MeowCatpawkittie
      url-base: https://github.com/MeowCatpawkittie
    # - name: ssbb
    #   url-base: https://github.com/ssbb
    # - name: kot149
    #   url-base: https://github.com/kot149
    # - name: 4mplelab
    #   url-base: https://github.com/4mplelab
    - name: BP
      url-base: https://github.com/taichan1113
    # - name: mctechnology17
    #   url-base: https://github.com/mctechnology17
    # - name: petejohanson
    #   url-base: https://github.com/petejohanson
    # - name: oleksandrmaslov
    #   url-base: https://github.com/oleksandrmaslov
    # - name: george-norton
    #   url-base: https://github.com/george-norton
  projects:
    - name: zmk
      # remote: zmkfirmware
      # revision: main
      remote: BP # <- analog input modification / deadlock fix
      # revision: deadlockfix
      revision: ensure-eof
      import: app/west.yml

    - name: zmk-rgbled-widget
      remote: caksoylar
      revision: main

    - name: zmk-pmw3610-driver
      remote: badjeff
      # revision: zmk-0.4
      revision: main

    - name: zmk-input-processor-report-rate-limit
      remote: badjeff
      revision: main

    - name: zmk-input-processor-xyz
      remote: badjeff
      revision: main

    - name: zmk-behavior-insomnia
      remote: badjeff
      revision: main

    # - name: zmk-analog-input-driver
    #   path: zmk-analog-input-driver
    #   remote: badjeff
    #   revision: main

    # - name: zmk-listeners
    #   remote: ssbb
    #   revision: v1

    # - name: zmk-layout-shift
    #   path: zmk-layout-shift
    #   remote: kot149
    #   revision: v1
    # - name: zmk-input-processor-keybind
    #   path: zmk-input-processor-keybind
    #   remote: te9no
    #   revision: main
    # - name: cirque-input-module
    #   path: cirque-input-module
    #   remote: petejohanson
    #   revision: main
    # - name: zmk-driver-MLX90393
    #   path: zmk-driver-MLX90393
    #   remote: te9no
    #   revision: main
    # - name: zmk-pointing-acceleration
    #   path: zmk-pointing-acceleration
    #   remote: oleksandrmaslov
    #   revision: main
    # - name: zmk-behavior-sensor-attr-cycle
    #   path: zmk-behavior-sensor-attr-cycle
    #   remote: badjeff
    #   revision: main
  self:
    path: config
    
```
