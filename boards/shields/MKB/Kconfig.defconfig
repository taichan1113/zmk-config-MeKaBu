## boards/shields/MKB/Kconfig.defconfig
```kconfig
if SHIELD_MKB_R||SHIELD_MKB_L
    config ZMK_KEYBOARD_NAME
        default "MeKaBu"
endif
```

## boards/shields/MKB_TB_CENTRAL/Kconfig.shield
```kconfig
config SHIELD_MKB_TB_CENTRAL
    def_bool $(shields_list_contains,MKB_TB_CENTRAL)
```

## boards/shields/MKB_TB_PERIPHERAL/Kconfig.shield
```kconfig
config SHIELD_MKB_TB_PERIPHERAL
    def_bool $(shields_list_contains,MKB_TB_PERIPHERAL)
```
